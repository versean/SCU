// *****************************************************************************
// this module for XOR
// *****************************************************************************
module XOR (A, B, Out);
  input A, B;
  output Out;
  assign Out = A^B;
endmodule //

// *****************************************************************************
// this module for N-bit full adder using behavior model
// *****************************************************************************
module NFullAdder(InA, InB, Cin, Sum, Cout);
  // ***************************************************************************
  // N is the number of bits
  // ***************************************************************************
  parameter  N = 4;

  // ***************************************************************************
  // set inputs and outputs
  // ***************************************************************************
  input  [N-1:0] InA, InB;
  input  Cin;
  output [N-1:0] Sum;
  output Cout;

  // ***************************************************************************
  // set the result for addition
  // ***************************************************************************
  wire   [N:0] AddVal;

  // ***************************************************************************
  // get the result
  // ***************************************************************************
  assign AddVal = InA + InB + Cin;
  assign Sum  = AddVal[N-1:0];
  assign Cout = AddVal[N];
endmodule

// *****************************************************************************
// this module for N-bit full adder using behavior model
// *****************************************************************************
module FullAddSub(InA, InB, CltSig, Sum, Cout);
  // ***************************************************************************
  // N is the number of bits
  // ***************************************************************************
  parameter  N = 4;

  // ***************************************************************************
  // set inputs and outputs
  // ***************************************************************************
  input  [N-1:0] InA, InB;
  input  Cin, CltSig;
  output [N-1:0] Sum;
  output Cout;

  // ***************************************************************************
  // set the result for addition
  // ***************************************************************************
  reg    [N-1:0] OutXor;
  // reg    Cin[0];
  // wire   CltSig;

  // ***************************************************************************
  // check for mode operation
  // ***************************************************************************
  always @* begin
    if (CltSig) begin
      // subtract operation
      OutXor = ~InB;
      // Cin = 1'b1;
    end
    else
      // add operation
      OutXor = InB;
  end

  // ***************************************************************************
  // adding operation
  // ***************************************************************************
  NFullAdder FAU0(.InA(InA), .InB(OutXor), .Cin(CltSig), .Sum(Sum), .Cout(Cout));
  defparam FAU0.N = N;

endmodule //

// *****************************************************************************
// this module generate truth table of variables
// *****************************************************************************
module GenInputPattern(Out, Clk, Reset);
  parameter  N = 8;
  output    [N-1:0] Out;
  input     Clk, Reset;

  // calculate maximum value of output
  localparam  MaxVal = 2 ** N - 1;

  // ***************************************************************************
  // type of output and inputs
  // ***************************************************************************
  wire 	    Clk, Reset;

  // ***************************************************************************
  // type reg because it is used on right hand side (RHS)
  // inside "always" block
  // ***************************************************************************
  reg       [N-1:0] Out;

  // ***************************************************************************
  // logic block
  // ***************************************************************************
  always @(posedge Clk or posedge Reset)
    if (Reset)
      Out <= 0;
    else if (Out >= MaxVal)
      Out <= 0;
    else
      Out <= Out + 1;
endmodule

// *****************************************************************************
// this module generate random number between 0 to 2^N - 1
// *****************************************************************************
module RandomGen(Clk, Out);
  parameter  N = 8;
  input  Clk;
  output [N-1:0] Out;

  // ***************************************************************************
  // calculate maximum value
  // ***************************************************************************
  localparam  MaxVal = 2 ** N - 1;

  // ***************************************************************************
  // define variable type
  // ***************************************************************************
  reg [N-1:0] Out;
  wire   Clk;

  // ***************************************************************************
  // logic block
  // ***************************************************************************
  always @(posedge Clk) begin
    Out = $urandom % MaxVal;
  end
endmodule

// *****************************************************************************
// this is the test module
// *****************************************************************************
module TestModule;
  /* Make a ResetSig that pulses once. */
  reg ResetSig = 0;
  reg CltSig = 0;
  initial begin
     # 4 ResetSig = 1;
     # 5 ResetSig = 0;
     // # 29 ResetSig = 1;
     // # 11 ResetSig = 0;
     # 15 CltSig = 1;
     # 50 CltSig = 0;
     # 155 $stop;
  end

  // ***************************************************************************
  // Make a regular pulsing clock.
  // ***************************************************************************
  reg        ClkSig = 0;
  always #5  ClkSig = !ClkSig;

  // ***************************************************************************
  // set the number of inputs
  // ***************************************************************************
  parameter NumInputs = 4;
  wire [NumInputs-1:0] InA, InB, Sum;
  wire Cout;

  integer seed;

  // ***************************************************************************
  // instantiate Truth table module
  // ***************************************************************************
  RandomGen U0Vals(.Clk(ClkSig), .Out(InA));
  defparam U0Vals.N = NumInputs;

  RandomGen U1Vals(.Clk(ClkSig), .Out(InB));
  defparam U1Vals.N = NumInputs;

  // ***************************************************************************
  // Full adder of N-bit numbers
  // ***************************************************************************
  FullAddSub TestU1 (.InA(InA), .InB(InB), .CltSig(CltSig), .Sum(Sum), .Cout(Cout));
  defparam TestU1.N = NumInputs;

  // ***************************************************************************
  // saving timing data
  // ***************************************************************************
  initial
    begin
      $dumpfile("Results.vcd");
      $dumpvars(0, TestModule);
      $display("+-------------------------------------------------------+");
      $display("|                   t | InA  |  InB | Ctl | Sum  | Cout |");
      $display("+-------------------------------------------------------+");
      $monitor("|%t | %b | %b | %3b | %b | %4b |", $time, InA, InB, CltSig, Sum, Cout);
    end
endmodule // test
