// *****************************************************************************
// this module describes the structural model of logic function in Example 8.4
// *****************************************************************************
module StructuralModel(In1, In2, In3, In4, Out);
  // ***************************************************************************
  // input and output port
  // ***************************************************************************
  input  In1, In2, In3, In4;
  output Out;

  // ***************************************************************************
  // wire connections within module
  // ***************************************************************************
  wire g, h;

  /// ***************************************************************************
  // logic connections
  // ***************************************************************************
  assign g = (In1 & In3) | (In2 & In4);
  assign h = (In1 | ~In3) & (~In2 | In4);
  assign Out = g | h;
endmodule

// // *****************************************************************************
// // this module describes the behavior model of logic function in Example 8.1
// // *****************************************************************************
// module BehavioralModel(In1, In2, In3, Out);
//   // ***************************************************************************
//   // input and output port
//   // ***************************************************************************
//   input  In1, In2, In3;
//   output Out;
//
//   // ***************************************************************************
//   // output F = (x1)!x2 + (x2)'x3
//   // ***************************************************************************
//   assign Out = (~In1 & In2) | (~In2 & In3);
// endmodule

// *****************************************************************************
// this module generate truth table of variables
// *****************************************************************************
module GenInputPattern(Out, Clk, Reset);
  parameter  N = 8;
  output    [N-1:0] Out;
  input     Clk, Reset;

  // calculate maximum value of output
  localparam  MaxVal = 2 ** N;

  // ***************************************************************************
  // type of output and inputs
  // ***************************************************************************
  wire 	    Clk, Reset;

  // ***************************************************************************
  // type reg because it is used on right hand side (RHS)
  // inside "always" block
  // ***************************************************************************
  reg       [N-1:0] Out;

  // ***************************************************************************
  // logic block
  // ***************************************************************************
  always @(posedge Clk or posedge Reset)
    if (Reset)
      Out <= 0;
    else if (Out >= MaxVal)
      Out <= 0;
    else
      Out <= Out + 1;
endmodule

// *****************************************************************************
// this is the test module
// *****************************************************************************
module TestModule;
  /* Make a ResetSig that pulses once. */
  reg ResetSig = 0;
  initial begin
     # 4 ResetSig = 1;
     # 5 ResetSig = 0;
     // # 29 ResetSig = 1;
     // # 11 ResetSig = 0;
     # 155 $stop;
  end

  // ***************************************************************************
  // Make a regular pulsing clock.
  // ***************************************************************************
  reg        ClkSig = 0;
  always #4  ClkSig = !ClkSig;

  // ***************************************************************************
  // set the number of inputs
  // ***************************************************************************
  parameter NumInputs = 4;
  wire      [NumInputs-1:0] InputVals;
  wire      F;

  // ***************************************************************************
  // Generate input pattern
  // ***************************************************************************
  GenInputPattern U0Input(.Out(InputVals), .Clk(ClkSig), .Reset(ResetSig));
  defparam U0Input.N = NumInputs;

  // ***************************************************************************
  // instantiate the function F
  // ***************************************************************************
  StructuralModel TestU1(.In1(InputVals[3]), .In2(InputVals[2]), .In3(InputVals[1]), .In4(InputVals[0]), .Out(F));

  // ***************************************************************************
  // saving timing data
  // ***************************************************************************
  initial begin
    $dumpfile("Results.vcd");
    $dumpvars(0, TestModule);
    $display("+------------------------------------+");
    $display("|                   t | x1x2x3x4 | F |");
    $display("+------------------------------------+");
    $monitor("|%t |   %b   | %b |", $time, InputVals, F);
  end
endmodule // test
