// *****************************************************************************
// this module for N-bit full adder using behavior model
// *****************************************************************************
module NFullAdder(Cin, InA, InB, Sum, Cout);
  // ***************************************************************************
  // N is the number of bits
  // ***************************************************************************
  parameter  N = 4;

  // ***************************************************************************
  // set inputs and outputs
  // ***************************************************************************
  input  Cin;
  input  [N-1:0] InA, InB;
  output [N-1:0] Sum;
  output Cout;

  // ***************************************************************************
  // set the result for addition
  // ***************************************************************************
  wire   [N:0] AddVal;

  // ***************************************************************************
  // get the result
  // ***************************************************************************
  assign AddVal = InA + InB + Cin;
  assign Sum  = AddVal[N-1:0];
  assign Cout = AddVal[N];
endmodule

// *****************************************************************************
// this module generate truth table of variables
// *****************************************************************************
module GenInputPattern(Out, Clk, Reset);
  parameter  N = 8;
  output    [N-1:0] Out;
  input     Clk, Reset;

  // calculate maximum value of output
  localparam  MaxVal = 2 ** N;

  // ***************************************************************************
  // type of output and inputs
  // ***************************************************************************
  wire 	    Clk, Reset;

  // ***************************************************************************
  // type reg because it is used on right hand side (RHS)
  // inside "always" block
  // ***************************************************************************
  reg       [N-1:0] Out;

  // ***************************************************************************
  // logic block
  // ***************************************************************************
  always @(posedge Clk or posedge Reset)
    if (Reset)
      Out <= 0;
    else if (Out >= MaxVal)
      Out <= 0;
    else
      Out <= Out + 1;
endmodule

// *****************************************************************************
// this module generate random number between 0 to 2^N - 1
// *****************************************************************************
module RandomGen(Clk, Out);
  parameter  N = 8;
  input  Clk;
  output [N-1:0] Out;

  // ***************************************************************************
  // calculate maximum value
  // ***************************************************************************
  localparam  MaxVal = 2 ** N - 1;

  // ***************************************************************************
  // define variable type
  // ***************************************************************************
  reg [N-1:0] Out;
  wire   Clk;

  // ***************************************************************************
  // logic block
  // ***************************************************************************
  always @(posedge Clk) begin
    Out = $urandom % MaxVal;
  end
endmodule

// *****************************************************************************
// this is the test module
// *****************************************************************************
module TestModule;
  /* Make a ResetSig that pulses once. */
  reg ResetSig = 0;
  initial begin
     # 4 ResetSig = 1;
     # 5 ResetSig = 0;
     // # 29 ResetSig = 1;
     // # 11 ResetSig = 0;
     # 155 $stop;
  end

  // ***************************************************************************
  // Make a regular pulsing clock.
  // ***************************************************************************
  reg        ClkSig = 0;
  always #4  ClkSig = !ClkSig;

  // ***************************************************************************
  // set the number of inputs
  // ***************************************************************************
  parameter NumInputs = 4;
  wire [NumInputs-1:0] InA, InB, Sum;
  wire Cin, Cout;

  // ***************************************************************************
  // Generate input pattern
  // ***************************************************************************
  RandomGen U0Vals(.Clk(ClkSig), .Out(InA));
  defparam U0Vals.N = NumInputs;

  RandomGen U1Vals(.Clk(ClkSig), .Out(InB));
  defparam U1Vals.N = NumInputs;

  // ***************************************************************************
  // set the input bits
  // ***************************************************************************
  assign Cin = InA[0];

  // ***************************************************************************
  // instantiate the function F
  // ***************************************************************************
  NFullAdder TestU1(.Cin(Cin), .InA(InA), .InB(InB), .Sum(Sum), .Cout(Cout));
  defparam TestU1.N = NumInputs;

  // ***************************************************************************
  // saving timing data
  // ***************************************************************************
  initial begin
  $dumpfile("Results.vcd");
  $dumpvars(0, TestModule);
  $display("+-------------------------------------------------------+");
  $display("|                   t | InA  | InB  | Cin | Cout | Sum  |");
  $display("+-------------------------------------------------------+");
  $monitor("|%t | %b | %b |  %b  |   %b  | %b |", $time, InA, InB, Cin, Cout, Sum);
  end
endmodule // test
